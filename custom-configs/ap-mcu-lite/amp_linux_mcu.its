## custom-configs/ap-mcu-lite/amp_linux_mcu.its
```
/* SPDX-License-Identifier: BSD-3-Clause */
/*
 * AP+MCU FIT image configuration
 *
 * Loads both real-time firmwares:
 *   - RT-Thread on CPU2 (amp2)
 *   - Bare-metal HAL on MCU
 *
 * Linux runs on CPU0 + CPU1
 */

/dts-v1/;
/ {
	description = "FIT source file for rockchip AMP (AP+MCU)";
	#address-cells = <1>;

	images {
		amp2 {
			description  = "rtos-core2";
			data         = /incbin/("rtt2.bin");
			type         = "firmware";
			compression  = "none";
			arch         = "arm";
			cpu          = <0xf02>;
			thumb        = <0>;
			hyp          = <0>;
			load         = <0x03e00000>;
			srambase     = <0xfff80000>;
			sramsize     = <0x0000c000>;
			compile {
				size     = <0x00100000>;
				sys      = "rtt";
				core     = "ap";
				rtt_config = "board/evb1/defconfig";
			};
			udelay       = <10000>;
			hash {
				algo = "sha256";
			};
		};

		mcu {
			description = "mcu";
			data = /incbin/("mcu.bin");
			type = "standalone";
			compression = "none";
			arch = "arm";
			load = <0xfff84000>;
			compile {
				size = <0x00800000>;
				sys = "hal";
				core = "mcu";
			};
			udelay = <1000000>;
			hash {
				algo = "sha256";
			};
		};
	};

	share {
		rpmsg_base = <0x03c00000>;
		rpmsg_size = <0x00200000>;
	};

	configurations {
		default = "conf";
		conf {
			description = "Rockchip AMP - AP+MCU";
			rollback-index = <0x0>;
			standalone = "mcu";
			loadables = "amp2", "mcu";

			signature {
				algo = "sha256,rsa2048";
				padding = "pss";
				key-name-hint = "dev";
				sign-images = "loadables";
			};

			linux {
				description  = "linux-os";
				arch         = "arm";
				cpu          = <0xf00>;
				thumb        = <0>;
				hyp          = <0>;
				load         = <0x00900000>;
				udelay       = <0>;
			};
		};
	};
};
```

## custom-configs/ap-only-lite/amp_linux.its
```
/* SPDX-License-Identifier: BSD-3-Clause */
/*
 * AP-only FIT image configuration
 *
 * Loads only RT-Thread on CPU2:
 *   - RT-Thread on CPU2 (amp2)
 *   - MCU not used
 *
 * Linux runs on CPU0 + CPU1
 */

/dts-v1/;
/ {
	description = "FIT source file for rockchip AMP (AP-only)";
	#address-cells = <1>;

	images {
		amp2 {
			description  = "rtos-core2";
			data         = /incbin/("rtt2.bin");
			type         = "firmware";
			compression  = "none";
			arch         = "arm";
			cpu          = <0xf02>;
			thumb        = <0>;
			hyp          = <0>;
			load         = <0x03e00000>;
			srambase     = <0xfff80000>;
			sramsize     = <0x0000c000>;
			compile {
				size     = <0x00100000>;
				sys      = "rtt";
				core     = "ap";
				rtt_config = "board/evb1/defconfig";
			};
			udelay       = <10000>;
			hash {
				algo = "sha256";
			};
		};
	};

	share {
		rpmsg_base = <0x03c00000>;
		rpmsg_size = <0x00200000>;
	};

	configurations {
		default = "conf";
		conf {
			description = "Rockchip AMP - AP only";
			rollback-index = <0x0>;
			loadables = "amp2";

			signature {
				algo = "sha256,rsa2048";
				padding = "pss";
				key-name-hint = "dev";
				sign-images = "loadables";
			};

			linux {
				description  = "linux-os";
				arch         = "arm";
				cpu          = <0xf00>;
				thumb        = <0>;
				hyp          = <0>;
				load         = <0x00900000>;
				udelay       = <0>;
			};
		};
	};
};
```

## custom-configs/mcu-only-lite/amp_linux_mcu_only.its
```
/* SPDX-License-Identifier: BSD-3-Clause */
/*
 * MCU-only AMP FIT image configuration
 *
 * This image contains ONLY the MCU firmware.
 * No RT-Thread (amp2) is included, so all 3 Cortex-A7 cores
 * remain available for Linux.
 *
 * Firmware loaded:
 *   - mcu.bin -> 0xfff84000 (MCU SRAM)
 *
 * NOT included:
 *   - amp2 (RT-Thread on CPU2)
 */

/dts-v1/;
/ {
	description = "FIT source file for rockchip AMP (MCU-only)";
	#address-cells = <1>;

	images {
		mcu {
			description = "mcu";
			data = /incbin/("mcu.bin");
			type = "standalone";
			compression = "none";
			arch = "arm";
			load = <0xfff84000>;
			compile {
				size = <0x00800000>;
				sys = "hal";
				core = "mcu";
			};
			udelay = <1000000>;
			hash {
				algo = "sha256";
			};
		};
	};

	share {
		/*
		 * RPMSG shared memory region
		 * Used for MCU <-> Linux communication
		 */
		rpmsg_base = <0x03c00000>;
		rpmsg_size = <0x00080000>;
	};

	configurations {
		default = "conf";
		conf {
			description = "Rockchip AMP - MCU only";
			rollback-index = <0x0>;
			standalone = "mcu";
			loadables = "mcu";

			signature {
				algo = "sha256,rsa2048";
				padding = "pss";
				key-name-hint = "dev";
				sign-images = "loadables";
			};

			/*
			 * Linux configuration
			 * Runs on all 3 CPUs (cpu0, cpu1, cpu2)
			 */
			linux {
				description  = "linux-os";
				arch         = "arm";
				cpu          = <0xf00>;
				thumb        = <0>;
				hyp          = <0>;
				load         = <0x00900000>;
				udelay       = <0>;
			};
		};
	};
};
```
